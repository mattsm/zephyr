## boards/arm/sdp_k1/Kconfig.board
```kconfig
# STM32F469I-DISCO board configuration

# Copyright (c) 2016 Linaro Limited.
# SPDX-License-Identifier: Apache-2.0

config BOARD_SDP_K1
	bool "SDK-K1 Development Board"
	depends on SOC_STM32F469XX
```

## boards/arm/sdp_k1/Kconfig.defconfig
```kconfig
# STM32F469I-DISCO board configuration

# Copyright (c) 2016 Linaro Limited.
# SPDX-License-Identifier: Apache-2.0

if BOARD_SDP_K1

config BOARD
	default "sdk_k1"

config SPI_STM32_INTERRUPT
	default y
	depends on SPI


endif # BOARD_SDP_K1
```
